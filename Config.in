## Config.in
```kconfig
mainmenu "X Router Configuration"

menu "Generic Options"

config ARCH
	string
	default "arm" if ARM
	default "arm64" if ARM64
	default "x86" if X86

choice
	prompt "ARCH"
	default ARM

config ARM
	bool "arm"

config ARM64
	bool "arm64"

config X86
	bool "x86"

endchoice

config TARBALL_DIR
	string "tarball directory"
	default "~/tarballs"

endmenu

source toolchain/Config.in
```

## toolchain/Config.in
```kconfig
menu "Toolchain Options"

config TOOLCHAIN_PATH
    string "Toolchain Path"
    default "toolchain/arm-linux-gnueabihf"

config CROSS_COMPILE_PREFIX
    string "Cross Compile Prefix"
    default "arm-linux-gnueabihf-"

endmenu
```
